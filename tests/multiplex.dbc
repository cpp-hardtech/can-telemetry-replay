VERSION "0.1"

NS_ :

BS_:

BU_: Sender Receiver

BO_ 2147483939 Status: 3 Sender
 SG_ Selector M : 0|8@1+ (1,0) [0|255] "" Receiver
 SG_ Flags m1 : 15|12@0+ (1,0) [0|4095] "" Receiver
 SG_ Offset m2 : 16|8@1- (1,0) [-128|127] "" Receiver
